## config/boards/shields/smallwave/Kconfig.defconfig
```kconfig
# Copyright (c) 2022 Duccio Breschi
# SPDX-License-Identifier: MIT

if SHIELD_SMALLWAVE_SUN

config ZMK_KEYBOARD_NAME
    default "smallwave"

config ZMK_SPLIT_ROLE_CENTRAL
    default y

endif

if SHIELD_SMALLWAVE_SUN || SHIELD_SMALLWAVE_MOON
config ZMK_SPLIT
    default y
endif
```

## config/boards/shields/smallwave/Kconfig.shield
```kconfig
# Copyright (c) 2022 Duccio Breschi
# SPDX-License-Identifier: MIT

config SHIELD_SMALLWAVE_SUN
    def_bool $(shields_list_contains,smallwave_sun)

config SHIELD_SMALLWAVE_MOON
    def_bool $(shields_list_contains,smallwave_moon)
```
